/*
 * SPI_PRG.c
 *
 *  Created on: Sep 23, 2025
 *      Author: BOLO
 */
//=========================================================
//=========================================================
//=========================================================

#include "main.h"
#include "inttypes.h"


//=========================================================
//=========================================================
//=========================================================
#define T_DATA_IN HAL_GPIO_ReadPin(T_MISO_GPIO_Port, T_MISO_Pin)

#define T_DO_HI HAL_GPIO_WritePin(T_MOSI_GPIO_Port, T_MOSI_Pin, SET)
#define T_DO_LO HAL_GPIO_WritePin(T_MOSI_GPIO_Port, T_MOSI_Pin, RESET)

#define T_CLK_HI HAL_GPIO_WritePin(T_CLK_GPIO_Port, T_CLK_Pin, SET)
#define T_CLK_LO HAL_GPIO_WritePin(T_CLK_GPIO_Port, T_CLK_Pin, RESET)

#define T_CS_HI HAL_GPIO_WritePin(T_CS_GPIO_Port, T_CS_Pin, SET)
#define T_CS_LO HAL_GPIO_WritePin(T_CS_GPIO_Port, T_CS_Pin, RESET)

//=========================================================
//=========================================================
//=========================================================

//=========================================================
//=========================================================
//=========================================================
void send_SPI_byte(uint8_t data){

	uint32_t i;
	for(i = 0 ; i < 8 ; i++){
		if((data & 0x80) != 0) T_DO_HI; 			// MSB TO MOSI
		else T_DO_LO;
		T_CLK_LO;
		data =(data << 1);
		T_CLK_HI;
	}
	__NOP();
	__NOP();
	__NOP();
	T_CLK_LO;
}
//=========================================================
uint8_t read_SPI_byte(void){

	uint8_t data = 0;
	uint8_t i;

	T_DO_HI;

	for(i=0; i<8; i++) {
		T_CLK_LO;
		data = (data << 1);
		data = data | T_DATA_IN;
		T_CLK_HI;
	}

	__NOP();
	__NOP();
	__NOP();
	T_CLK_LO;
	return data;
}
//=========================================================

//=========================================================
//=========================================================
//=========================================================
//=========================================================
//=========================================================
//=========================================================

